#include "LCDModule.h"
#include "NTPModule.h"
#include "SensorModule.h"
#include "logo.h"

extern NTPModule* ntpModule;
extern SensorModule* sensorModule;
extern const char* MEOBOT_VERSION;

void LCDModule::displayLogo() {
    u8g2->firstPage();
  do
  {
    u8g2->drawXBM(-10, 0, 128, 64, logo);
    u8g2->setFont(u8g2_font_logisoso16_tr);
    u8g2->setCursor(36, 28);
    u8g2->print("3E-MeoBot"); 
    
    u8g2->setCursor(40, 46);
    u8g2->setFont(u8g2_font_10x20_te);
    u8g2->print("v"); 
    u8g2->print(String(MEOBOT_VERSION)); 
  } while (u8g2->nextPage()); 
  delay(2000);
}

void LCDModule::displayConfigWiFi() {
  char strID[10];
  sprintf(strID, "%08x", ESP.getChipId());

  u8g2->firstPage();
  do {
      u8g2->setFont(u8g2_font_ncenB10_tr);
      u8g2->setCursor(0, 11);
      u8g2->print("Config Mode");
      u8g2->setFont(u8g2_font_ncenB08_tr);
      u8g2->setCursor(0, u8g2->getDisplayHeight()/2);
      u8g2->print(" CMMC-");
      u8g2->print(strID);
  } while (u8g2->nextPage()); 
}

void LCDModule::displayConnectingWiFi(const char* sta_ssid, int count) {
    u8g2->firstPage();
    do
    {
      u8g2->setFont(u8g2_font_unifont_t_symbols);
      u8g2->setCursor(0, 11);
      u8g2->print("Connecting WiFi");
      u8g2->setFont(u8g2_font_unifont_t_symbols);
      // https://github.com/olikraus/u8g2/wiki/u8g2reference
      u8g2->drawGlyph(0+4, 25+3, 9680+count%7);
      u8g2->setFont(u8g2_font_siji_t_6x10);
      u8g2->setCursor(10, 25);
      u8g2->print(" ");
      u8g2->print(sta_ssid);
    } while (u8g2->nextPage()); 
}

void LCDModule::displayWiFiConnected() {
    // u8g2->firstPage();
    // do
    // {
    //   u8g2->setFont(u8g2_font_ncenB10_tr);
    //   u8g2->setCursor(0, 11);
    //   u8g2->print("3E-BOT");
    //   u8g2->setFont(u8g2_font_ncenB08_tr);
    //   u8g2->setCursor(0, 25);
    //   u8g2->print("WiFi Connected.");
    // } while (u8g2->nextPage()); 
}

void LCDModule::configLoop() {
  if (digitalRead(0) == LOW) {
    while(digitalRead(0) == LOW) {
      delay(10); 
    } 
    File f = SPIFFS.open("/enabled", "a+");
    delay(100);
    digitalWrite(0, HIGH);
    ESP.restart();
  }
}

void LCDModule::config(CMMC_System *os, AsyncWebServer *server)
{
  u8g2 = new U8G2_ST7920_128X64_1_SW_SPI(U8G2_R0, /* clock=*/14, /* data=*/13, /* CS=*/12);
  u8g2->begin(); 
  u8g2->enableUTF8Print();
  displayLogo();
}

void LCDModule::configWebServer()
{
  static LCDModule *that = this;
}

void LCDModule::setup()
{
}

void LCDModule::loop() {
  static const uint8_t logo[128 * 64 / 8] = {
  0x00, 0x00, 0x00, 0x00, 0x00, 0x00, 0x00, 0x00, 0x00, 0x00, 0x00, 0x00, 
  0x00, 0x00, 0x00, 0x00, 0x00, 0x00, 0x00, 0x00, 0x00, 0x00, 0x00, 0x00, 
  0x00, 0x00, 0x00, 0x00, 0x00, 0x00, 0x00, 0x00, 0x00, 0x00, 0x00, 0x00, 
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  0x00, 0x00, 0x00, 0x00, }; 

  interval.every_ms(1000, [=]() {
    u8g2->firstPage();
    int factor = micros()%6;
    factor = +5;
    do
    {
      // u8g2->drawXBM(0,0,128,64, logo); 
      u8g2->setFont(u8g2_font_p01type_tn); 
      u8g2->setCursor(90, 6);
      u8g2->print(ntpModule->getTimeString());

      u8g2->setFont(u8g2_font_siji_t_6x10);
      u8g2->setCursor(10, 13);
      u8g2->print("3E-MeoBot"); 

      u8g2->setFont(u8g2_font_siji_t_6x10);
      u8g2->setCursor(12, 24);
      u8g2->print("Weather"); 

      u8g2->setCursor(12, 32);
      u8g2->print("station"); 

      u8g2->setFont(u8g2_font_open_iconic_weather_4x_t);
      u8g2->drawGlyph(84, 41, 64+factor);

      int marginLeft = 6;
      u8g2->setFont(u8g2_font_logisoso16_tf);
      u8g2->setCursor(6+marginLeft, 60);
      u8g2->print(sensorModule->getTemperatureString());
      u8g2->print("°C");

      u8g2->setCursor(78+marginLeft, 60);
      u8g2->print(sensorModule->getHumidityString());
      u8g2->print("%"); 
    } while (u8g2->nextPage()); 
  }); 
} 